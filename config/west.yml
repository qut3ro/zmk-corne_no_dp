## config/west.yml
```yaml
manifest:
  remotes:
    - name: zmkfirmware
      url-base: https://github.com/zmkfirmware
    - name: jewtvet
      url-base: https://github.com/jewtvet
  projects:
    - name: zmk
      remote: zmkfirmware
      revision: v0.3
      import: app/west.yml
    - name: zmk-ruen
      remote: jewtvet
      revision: main
  self:
    path: config
```
